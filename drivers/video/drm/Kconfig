## drivers/video/drm/Kconfig
```kconfig
menuconfig DRM_ROCKCHIP
	bool "Rockchip DRM Support"
	depends on DM_VIDEO
	help
	  Rockchip SoCs provide video output capabilities for High-Definition
	  Multimedia Interface (HDMI), Low-voltage Differential Signalling
	  (LVDS), embedded DisplayPort (eDP) and Display Serial Interface (DSI).

	  This driver supports the on-chip video output device, and targets the
	  Rockchip RK3288 and RK3399.

config DRM_ROCKCHIP_DW_HDMI
        bool "Rockchip specific extensions for Synopsys DW HDMI"
        depends on DRM_ROCKCHIP
        help
         This selects support for Rockchip SoC specific extensions
         for the Synopsys DesignWare HDMI driver. If you want to
         enable HDMI on, you should selet this option.

config ROCKCHIP_INNO_HDMI_PHY
        bool "Rockchip specific extensions for INNO HDMI PHY"
        depends on DRM_ROCKCHIP
        help
         This selects support for INNO HDMI PHY. If you want to
         use HDMI or TVE in RK322XH or RK322X, you should selet
         this option.
```
